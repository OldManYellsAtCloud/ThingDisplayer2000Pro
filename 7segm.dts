/dts-v1/;
/plugin/;

/ {
    compatible = "brcm,bcm2835";

    fragment@0 {
	target = <&i2c1>;
	__overlay__ {
	    status = "okay";

	    #address-cells = <1>;
	    #size-cells = <0>;

	    sevensegment: sevsegm@70{
		compatible = "sparkfun,7segment";
		reg = <0x70>;
	    };
	};
    };
};
